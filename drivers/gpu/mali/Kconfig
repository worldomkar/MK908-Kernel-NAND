## drivers/gpu/mali/Kconfig
```kconfig
config MALI
	bool "ARM Mali GPU modules"
	depends on ARM && m
        select MALI400
        select UMP
	default n
	help
	  This enables the generation of mali.ko and ump.ko.

source "drivers/gpu/mali/ump/Kconfig"
source "drivers/gpu/mali/mali/Kconfig"
```
